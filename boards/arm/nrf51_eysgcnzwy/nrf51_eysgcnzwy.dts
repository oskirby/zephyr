/*
 * Copyright (c) 2018 Owen Kirby <oskirby@gmail.com>
 *
 * SPDX-License-Identifier: Apache-2.0
 */

/dts-v1/;
#include <nordic/nrf51822.dtsi>

/ {
	model = "Taiyo Yuden EYSGCNZWY";
	compatible = "taiyo,EYSGCNZWY", "nordic,nrf51822-qfac", "nordic,nrf51822";

	chosen {
		zephyr,console = &uart0;
		zephyr,sram = &sram0;
		zephyr,flash = &flash0;
	};
};

&uart0 {
	current-speed = <115200>;
	status = "ok";
};
