## arch/arm/soc/nordic_nrf/nrf51/Kconfig.defconfig.series
```kconfig
# Kconfig.defconfig.series - Nordic Semiconductor nRF51 MCU line
#
# Copyright (c) 2016 Linaro Limited
# Copyright (c) 2018 Nordic Semiconductor ASA
#
# SPDX-License-Identifier: Apache-2.0
#

if SOC_SERIES_NRF51X

gsource "arch/arm/soc/nordic_nrf/nrf51/Kconfig.defconfig.nrf51*"

config SOC_SERIES
	default "nrf51"

config SYS_CLOCK_HW_CYCLES_PER_SEC
	int
	default 32768

config SYS_CLOCK_XTALFREQ
	int "System clock's external crystal frequency"
	default 16000000
	help
	  This option specifies the frequency of the external crystal used for the
	  system clock (in Hz). This option is set by the board's Kconfig file
	  and the user should generally avoid modifying it via the menu configuration.

config SYS_POWER_MANAGEMENT
	default y

config NUM_IRQS
	int
	default 26

if SENSOR

config TEMP_NRF5
	def_bool y

endif # SENSOR

endif # SOC_SERIES_NRF51X
```

## boards/arm/nrf51_beacon/Kconfig.board
```kconfig
# Kconfig - nRF51 Beacon board configuration
#
# Copyright (c) 2018 Owen Kirby <oskirby@gmail.com>
#
# SPDX-License-Identifier: Apache-2.0

config BOARD_NRF51_BEACON
	bool "nRF51 Beacon"
	depends on SOC_NRF51822_QFAA
```

## boards/arm/nrf51_beacon/Kconfig.defconfig
```kconfig
# Kconfig - nRF51 BLENANO board configuration
#
# Copyright (c) 2016 Nordic Semiconductor ASA
#
# SPDX-License-Identifier: Apache-2.0

if BOARD_NRF51_BEACON

config BOARD
	default "nrf51_beacon"

if GPIO_NRF5

config GPIO_NRF5_P0
	default y

endif # GPIO_NRF5

if UART_NRFX

config UART_0_NRF_TX_PIN
	default 9

config UART_0_NRF_RX_PIN
	default 11

endif # UART_NRFX

endif # BOARD_NRF51_BEACON
```

## boards/arm/nrf51_eysgcnzwy/Kconfig.board
```kconfig
# Kconfig - Taiyo Yuden EYSGCNZWY board configuration
#
# Copyright (c) 2018 Owen Kirby <oskirby@gmail.com>
#
# SPDX-License-Identifier: Apache-2.0

config BOARD_NRF51_EYSGCNZWY
	bool "nRF51 EYSGCNZWY"
	depends on SOC_NRF51822_QFAC
```

## boards/arm/nrf51_eysgcnzwy/Kconfig.defconfig
```kconfig
# Kconfig - nRF51 EYSGCNZWY module configuration
#
# Copyright (c) 2018 Owen Kirby <oskirby@gmail.com>
#
# SPDX-License-Identifier: Apache-2.0

if BOARD_NRF51_EYSGCNZWY

config BOARD
	default "nrf51_eysgcnzwy"

if GPIO_NRF5

config GPIO_NRF5_P0
	default y

endif # GPIO_NRF5

if UART_NRFX

config UART_0_NRF_TX_PIN
	default 1

config UART_0_NRF_RX_PIN
	default 3

config UART_0_NRF_RTS_PIN
	default 0

config UART_0_NRF_CTS_PIN
	default 2

endif # UART_NRFX

endif # BOARD_NRF51_EYSGCNZWY
```
